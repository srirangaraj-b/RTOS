## CMakeLists.txt
```
cmake_minimum_required(VERSION 3.20.0)
find_package(Zephyr REQUIRED HINTS $ENV{ZEPHYR_BASE})
project(serial_print)
target_sources(app PRIVATE src/main.c)
```

## prj.conf
```kconfig
CONFIG_SERIAL=y
CONFIG_PRINTK=y

#only for pico boards (USB CDC)
#west build -p always -b rpi_pico . -S cdc-acm-console
CONFIG_USB_DEVICE_STACK_NEXT=y
CONFIG_CDC_ACM_SERIAL_INITIALIZE_AT_BOOT=y
```

## src/main.c
```c
#include <zephyr/kernel.h>
#include <zephyr/sys/printk.h>

int main(void)
{

	while (1) {
		printk("Hello World!!!, from Zephyr RTOS\n");
		k_msleep(1000);
	}
}

// for pico devices west build -p always -b rpi_pico . -S cdc-acm-console

// Either each time add -S cdc-acm-console or add this in overlay


// / {
// 	chosen {
// 		zephyr,console = &cdc_acm_uart0;
// 	};
// };

// &zephyr_udc0 {
// 	cdc_acm_uart0: cdc_acm_uart0 {
// 		compatible = "zephyr,cdc-acm-uart";
// 	};
// };
```
