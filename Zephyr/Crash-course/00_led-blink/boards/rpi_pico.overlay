#include <zephyr/dt-bindings/gpio/gpio.h>

/{
    leds{
        compatible = "gpio-leds";

        my_led: led_1 {
            gpios = <&gpio0 2 GPIO_ACTIVE_LOW>;
        };
    };

    aliases{
        my-led = &my_led;
    };
};